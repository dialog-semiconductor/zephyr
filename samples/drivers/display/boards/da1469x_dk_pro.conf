## samples/drivers/display/boards/da1469x_dk_pro.conf
```kconfig
#
# Copyright (c) 2023 Renesas Electronics Corporation
#
# SPDX-License-Identifier: Apache-2.0
#
#
CONFIG_HEAP_MEM_POOL_SIZE=153600
CONFIG_LOG_MODE_MINIMAL=y
CONFIG_MIPI_DBI_LOG_LEVEL_DBG=y
```

## soc/arm/renesas_smartbond/Kconfig.defconfig
```kconfig
# Copyright (c) 2022 Renesas Electronics Corporation
# SPDX-License-Identifier: Apache-2.0

if SOC_FAMILY_SMARTBOND

source "soc/arm/renesas_smartbond/*/Kconfig.defconfig.series"

config PINCTRL
	default y

config BT_WAIT_NOP
	default y if BT

choice BT_RECV_CONTEXT
	default BT_RECV_BLOCKING if BT
endchoice

config TEST_RANDOM_GENERATOR
	default y if BT

endif # SOC_FAMILY_SMARTBOND
```

## soc/arm/renesas_smartbond/da1469x/Kconfig.defconfig.da14695
```kconfig
# Copyright (c) 2023 Renesas Electronics Corporation
# SPDX-License-Identifier: Apache-2.0

if SOC_DA14695

config SOC
	default "da14695"

endif # SOC_DA14695
```

## soc/arm/renesas_smartbond/da1470x/Kconfig.defconfig.da14706
```kconfig
# Copyright (c) 2023 Renesas Electronics Corporation and/or its affiliates
# SPDX-License-Identifier: Apache-2.0

if SOC_DA14706

config SOC
	default "da14706"

endif # SOC_DA14706
```

## soc/arm/renesas_smartbond/da1470x/Kconfig.series
```kconfig
# Copyright (c) 2023 Renesas Electronics Corporation and/or its affiliates
# SPDX-License-Identifier: Apache-2.0

config SOC_SERIES_DA1470X
	bool "Renesas SmartBond(tm) DA1470x series MCU"
	select ARM
	select CPU_CORTEX_M33
	select CPU_HAS_FPU
	select CPU_HAS_ARM_MPU
	select CPU_CORTEX_M_HAS_SYSTICK
	select SOC_FAMILY_SMARTBOND
	select HAS_SEGGER_RTT
	#select CLOCK_CONTROL
	#select CLOCK_CONTROL_SMARTBOND
	help
	  Enable support for Renesas SmartBond(tm) DA1470x MCU series
```

## soc/arm/renesas_smartbond/da1470x/Kconfig.soc
```kconfig
# Copyright (c) 2023 Renesas Electronics Corporation and/or its affiliates
# SPDX-License-Identifier: Apache-2.0

choice
	prompt "Renesas SmartBond(tm) DA1470x MCU selection"
	depends on SOC_SERIES_DA1470X

config SOC_DA14706
	bool "DA14706"

endchoice
```

## soc/renesas/smartbond/Kconfig.defconfig
```kconfig
# Copyright (c) 2022 Renesas Electronics Corporation
# SPDX-License-Identifier: Apache-2.0

if SOC_FAMILY_RENESAS_SMARTBOND

rsource "*/Kconfig.defconfig"

config PINCTRL
	default y

config BT_WAIT_NOP
	default y if BT

config TEST_RANDOM_GENERATOR
	default y if BT

endif # SOC_FAMILY_RENESAS_SMARTBOND
```
