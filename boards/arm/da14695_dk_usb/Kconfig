## boards/arm/da14695_dk_usb/Kconfig.defconfig
```kconfig
# DA14695 Development Kit USB board configuration

# Copyright (c) 2023 Renesas Electronics Corporation and/or its affiliates
# SPDX-License-Identifier: Apache-2.0

if BOARD_DA14695_DK_USB

config BOARD
	default "da14695_dk_usb"

choice BT_HCI_BUS_TYPE
	default BT_DA1469X if BT
endchoice

endif # BOARD_DA14695_DK_USB
```

## boards/arm/da14695_pico/Kconfig.board
```kconfig
# DA14695 Pico configuration

# Copyright (c) 2022 Renesas Electronics Corporation
# SPDX-License-Identifier: Apache-2.0

config BOARD_DA14695_PICO
	bool "DA14695 Pico"
	depends on SOC_SERIES_DA1469X
```

## boards/arm/da14695_pico/Kconfig.defconfig
```kconfig
# DA14695 Pico configuration

# Copyright (c) 2022 Renesas Electronics Corporation
# SPDX-License-Identifier: Apache-2.0

if BOARD_DA14695_PICO

config BOARD
	default "da14695_pico"

choice BT_HCI_BUS_TYPE
	default BT_DA1469X if BT
endchoice

endif # BOARD_DA14695_PICO
```

## boards/arm/da14695_pico/da14695_pico_defconfig
```kconfig
# SPDX-License-Identifier: Apache-2.0

CONFIG_SOC_SERIES_DA1469X=y
CONFIG_SOC_DA14695=y
CONFIG_BOARD_DA14695_PICO=y

CONFIG_HW_STACK_PROTECTION=y
CONFIG_CLOCK_CONTROL=y
CONFIG_CLOCK_CONTROL_SMARTBOND=y

CONFIG_GPIO=y

CONFIG_CONSOLE=y
CONFIG_UART_CONSOLE=y
CONFIG_SERIAL=y

CONFIG_BUILD_OUTPUT_HEX=n

CONFIG_I2C=y
CONFIG_I2C_CALLBACK=y
CONFIG_SPI=y

CONFIG_FLASH=y
CONFIG_FLASH_MAP=y
CONFIG_FLASH_PAGE_LAYOUT=y

CONFIG_FILE_SYSTEM=y
CONFIG_FILE_SYSTEM_LITTLEFS=y
```

## boards/arm/da1469x_dk_pro/Kconfig.defconfig
```kconfig
# DA1469x series Development Kit Pro board configuration

# Copyright (c) 2022 Renesas Electronics Corporation
# SPDX-License-Identifier: Apache-2.0

if BOARD_DA1469X_DK_PRO

config BOARD
	default "da1469x_dk_pro"

if LVGL

config LV_Z_VDB_ALIGN
	default 4

config LV_Z_BITS_PER_PIXEL
	default 16

endif # LVGL

if INPUT

config INPUT_FT5336_INTERRUPT
	default y

config LV_Z_POINTER_INPUT_MSGQ_COUNT
	default 70

endif # INPUT

endif # BOARD_DA1469X_DK_PRO
```

## boards/arm/da1470x_dk_pro/Kconfig.board
```kconfig
# DA1470x series Development Kit Pro board configuration

# Copyright (c) 2023 Renesas Electronics Corporation and/or its affiliates
# SPDX-License-Identifier: Apache-2.0

config BOARD_DA1470X_DK_PRO
	bool "DA1470x series Development Kit Pro board"
	depends on SOC_SERIES_DA1470X
```

## boards/arm/da1470x_dk_pro/Kconfig.defconfig
```kconfig
# DA1470x series Development Kit Pro board configuration

# Copyright (c) 2023 Renesas Electronics Corporation and/or its affiliates
# SPDX-License-Identifier: Apache-2.0

if BOARD_DA1470X_DK_PRO

config BOARD
	default "da1470x_dk_pro"

endif # BOARD_DA1470X_DK_PRO
```

## boards/arm/da1470x_dk_pro/da1470x_dk_pro_defconfig
```kconfig
# SPDX-License-Identifier: Apache-2.0

CONFIG_SOC_SERIES_DA1470X=y
CONFIG_SOC_DA14706=y
CONFIG_BOARD_DA1470X_DK_PRO=y

CONFIG_HW_STACK_PROTECTION=y

CONFIG_GPIO=y

CONFIG_CONSOLE=y
CONFIG_UART_CONSOLE=y
CONFIG_SERIAL=y

CONFIG_BUILD_OUTPUT_HEX=n
CONFIG_DEBUG_OPTIMIZATIONS=y
#CONFIG_BOOTLOADER_MCUBOOT=y

#CONFIG_I2C=y
#CONFIG_I2C_CALLBACK=y

CONFIG_ARM_MPU=y
CONFIG_MPU_STACK_GUARD=y
```

## drivers/adc/Kconfig.smartbond
```kconfig
# ADC configuration options

# Copyright (c) 2023 Renesas Electronics Corporation
# SPDX-License-Identifier: Apache-2.0

config ADC_SMARTBOND_GPADC
	bool "Smartbond ADC driver for ADC"
	default y
	depends on DT_HAS_RENESAS_SMARTBOND_ADC_ENABLED
	select ADC_CONFIGURABLE_INPUTS
	help
	  Enable support for ADC driver for Smartbond MCU series.

config ADC_SMARTBOND_SDADC
	bool "Smartbond ADC driver for Sigma-Delta ADC"
	default y
	depends on DT_HAS_RENESAS_SMARTBOND_SDADC_ENABLED
	select ADC_CONFIGURABLE_INPUTS
	help
	  Enable support for ADC driver for Smartbond MCU series.
```

## drivers/clock_control/Kconfig.smartbond
```kconfig
# Smartbond clock control driver config

# Copyright (c) 2022 Renesas Electronics Corporation
# SPDX-License-Identifier: Apache-2.0

menuconfig CLOCK_CONTROL_SMARTBOND
	bool "Smartbond Clock Control"
	depends on SOC_FAMILY_SMARTBOND
	help
	  Enable driver for Clock Control subsystem found in SmartBond

if CLOCK_CONTROL_SMARTBOND

endif # CLOCK_CONTROL_SMARTBOND
```

## drivers/crypto/Kconfig.smartbond
```kconfig
# Smartbond Cryptographic Accelerator configuration options

# Copyright (c) 2020 Markus Fuchs <markus.fuchs@de.sauter-bc.com>
# SPDX-License-Identifier: Apache-2.0

menuconfig CRYPTO_SMARTBOND
	bool "Smartbond Cryptographic Accelerator driver"
	default y
	help
	  Enable Smartbond Cryptographic Accelerator driver.

config CRYPTO_SMARTBOND_MAX_SESSION
	int "Maximum of sessions Smartbond crypto driver can handle"
	default 1
	depends on CRYPTO_SMARTBOND
	help
	  This can be used to tweak the amount of sessions the driver
	  can handle in parallel.

config CRYPTO_SMARTBOND_DRV_NAME
	string "Device name for Smartbond crypto device"
	default "CRYPTO_SMARTBOND"
	depends on CRYPTO_SMARTBOND
	help
	  Device name for Smartbond crypto device.

config CRYPTO_ASYNC
	string "Enable ASYNC crypto operations."
	default n
	depends on CRYPTO_SMARTBOND
	help
	  Enable ASYNC crypto operations.
```

## drivers/regulator/Kconfig.da1469x
```kconfig
# Copyright 2023 Jerzy Kasenberg
# SPDX-License-Identifier: Apache-2.0

config REGULATOR_DA1469X
	bool "DA1469X regulators driver"
	default y
	depends on DT_HAS_RENESAS_SMARTBOND_REGULATOR_ENABLED
	help
	  Enable support for the Smartbond DA1469x regulators.

if REGULATOR_DA1469X

config REGULATOR_DA1469X_INIT_PRIORITY
	int "Renesas DA1469x regulators driver init priority"
	default KERNEL_INIT_PRIORITY_OBJECTS
	help
	  Init priority for the Renesas DA1469x regulators driver.

endif # REGULATOR_DA1469X
```

## drivers/sensor/renesas/rrh46410/Kconfig
```kconfig
# RRH46410 air quality sensor
# SPDX-License-Identifier: Apache-2.0

menuconfig RRH46410
	bool "RRH46410 sensor"
	default y
	depends on DT_HAS_RENESAS_RRH46410_ENABLED
	depends on UART_INTERRUPT_DRIVEN
	depends on GPIO

	help
	  Enable driver for RRH46410 TVOC sensor.
```

## drivers/sensor/renesas/rrh62000/Kconfig
```kconfig
# RRH62000 All-in-One Integrated Sensor Module for PM2.5, RHT, TVOC, and eCO2 Detection
# SPDX-License-Identifier: Apache-2.0

menuconfig RRH62000
	bool "RRH62000 sensor"
	default y
	depends on DT_HAS_RENESAS_RRH62000_ENABLED
	depends on UART_INTERRUPT_DRIVEN
	
	help
	  Enable driver for RRH62000 All-in-One Integrated Sensor Module for PM2.5, RHT, TVOC, and eCO2 Detection.
```

## dts/bindings/adc/renesas,smartbond-gpadc.yaml
```yaml
# Copyright (c) 2023 Renesas Electronics Corporation
# SPDX-License-Identifier: Apache-2.0

description: Smartbond ADC node

compatible: "renesas,smartbond-adc"

include: [adc-controller.yaml, pinctrl-device.yaml]

properties:
  reg:
    required: true

  interrupts:
    required: true

  "#io-channel-cells":
    const: 1

  pinctrl-0:
    required: true

  pinctrl-names:
    required: true

io-channel-cells:
  - input
```

## dts/bindings/adc/renesas,smartbond-sdadc.yaml
```yaml
# Copyright (c) 2023 Renesas Electronics Corporation
# SPDX-License-Identifier: Apache-2.0

description: Smartbond ADC node

compatible: "renesas,smartbond-sdadc"

include: [adc-controller.yaml, pinctrl-device.yaml]

properties:
    reg:
      required: true

    interrupts:
      required: true

    "#io-channel-cells":
      const: 1

    clock-freq:
        type: int
        required: false
        description: |
            SDADC clock frequency selector;
        enum:
            - 0 # 250 kHz
            - 1 # 500 kHz
            - 2 # 1 MHz (default)
            - 3 # 2 MHz

    pinctrl-0:
        required: false

    pinctrl-names:
        required: false

io-channel-cells:
    - input
```

## dts/bindings/clock/renesas,smartbond-clock.yaml
```yaml
# Copyright (c) 2022 Renesas Electronics Corporation
# SPDX-License-Identifier: Apache-2.0

description: Renesas Smartbond clock control node

compatible: "renesas,smartbodn-clock"

include: base.yaml

properties:
    reg:
      required: true
```

## dts/bindings/mipi-dbi/mipi-dbi-device.yaml
```yaml
# Copyright 2023 NXP
# SPDX-License-Identifier: Apache-2.0
#
# Common fields for MIPI-DBI devices

include: [base.yaml, power.yaml]

on-bus: mipi-dbi

properties:
  mipi-max-frequency:
    type: int
    description: Maximum clock frequency of device's MIPI interface in Hz
  duplex:
    type: int
    default: 0
    description: |
      SPI Duplex mode, full or half. By default it's always full duplex thus 0
      as this is, by far, the most common mode.
      Use the macros not the actual enum value, here is the concordance
      list (see dt-bindings/spi/spi.h)
        0    SPI_FULL_DUPLEX
        2048 SPI_HALF_DUPLEX
```

## dts/bindings/mipi-dbi/renesas,smartbond-mipi-dbi.yaml
```yaml
# Copyright (c) 2023 Renesas Electronics Corporation
# SPDX-License-Identifier: Apache-2.0

include: [mipi-dbi-controller.yaml, pinctrl-device.yaml]

description: Renesas Smartbond(tm) MIPI DBI Host

compatible: "renesas,smartbond-mipi-dbi"

properties:
  reg:
    required: true

  interrupts:
    required: true

  reset-gpios:
    type: phandle-array
    description: |
      Reset GPIO pin. Used to reset the display during initialization.

  te-enable:
    type: boolean
    description: |
      Boolean to indicate whether the tearing effect (TE) signal is available or not.

  te-inversion:
    type: boolean
    description: |
      Boolean to apply an inversion on the TE signal that triggers the MIPI DBI controller.

  dma-prefetch:
    type: int
    enum:
      - 0 # Prefetch mechanism is disabled
      - 1 # Host will wait for at least 44 bytes
      - 2 # Host will wait for at least 84 bytes
      - 3 # Host will wait for at least 116 bytes
      - 4 # Host will wait for at least 108 bytes
    description: |
      Host controller will wait for at least the specified number of bytes before triggering
      a single frame update. The prefetch mechanism should be enabled when frame buffer(s)
      is stored into external storage mediums, e.g. PSRAM, that introduce comparable delays.
      Users should make sure the total number of bytes, a frame update consists of, should exceed
      the prefetch level. Otherwise, host controller will not be able to trigger the frame update.

  spi-dev:
    type: phandle
    description: |
      SPI device to use for data transfers with MIPI DBI commands. This SPI
      device should be connected to the MIPI DBI display.
```

## dts/bindings/rtc/renesas,smartbond-rtc.yaml
```yaml
# Copyright (c) 2023 Renesas Electronics Corporation
# SPDX-License-Identifier: Apache-2.0

description: Renesas SmartBond(tm) RTC node

compatible: "renesas,smartbond-rtc"

include: base.yaml

properties:
  reg:
    required: true

  interrupts:
    required: true
```

## dts/bindings/sensor/renesas,rrh46410-i2c.yaml
```yaml
#
# Copyright (c) 2024 Renesas
#
# SPDX-License-Identifier: Apache-2.0

description: Renesas RRH46410 TVOC sensor

compatible: "renesas,rrh46410"

include: [i2c-device.yaml, "renesas,rrh46410.yaml"]

#properties:
#  reset-gpios:
#    type: phandle-array
#    description: |
#      The RESETn pin is asserted to disable the sensor causing a hard
#      reset.  The sensor receives this as an active-low signal.
```

## dts/bindings/sensor/renesas,rrh62000.yaml
```yaml
#
# Copyright (c) 2024
#
# SPDX-License-Identifier: Apache-2.0

description: Renesas RRH62000 All-in-One Integrated Sensor Module for PM2.5, RHT, TVOC, and eCO2 Detection

compatible: "renesas,rrh62000"

include: [sensor-device.yaml, uart-device.yaml]
```
