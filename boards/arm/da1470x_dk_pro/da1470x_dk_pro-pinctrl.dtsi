/*
 * Copyright (c) 2023 Renesas Electronics Corporation and/or its affiliates
 * SPDX-License-Identifier: Apache-2.0
 */

#include <zephyr/dt-bindings/pinctrl/smartbond-pinctrl.h>

&pinctrl {
	uart_default: uart_default {
		group1 {
			pinmux = <SMARTBOND_PINMUX(UART_TX, 0, 8)>;
		};
		group2 {
			pinmux = <SMARTBOND_PINMUX(UART_RX, 2, 1)>;
			bias-pull-up;
		};
	};
};
